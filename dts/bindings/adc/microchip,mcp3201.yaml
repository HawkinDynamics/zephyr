## dts/bindings/adc/microchip,mcp3201.yaml
```yaml
description: Microchip MCP3201

compatible: "microchip,mcp3201"

include: microchip,mcp320x-base.yaml
```

## dts/bindings/adc/microchip,mcp3202.yaml
```yaml
description: Microchip MCP3202

compatible: "microchip,mcp3202"

include: microchip,mcp320x-base.yaml
```
